## drivers/sensor/csse4011_qmp6988/Kconfig
```kconfig
config CSSE4011_QMP6988
	bool "QMP6988 pressure sensor driver"
	depends on SENSOR
	depends on I2C
	default n
	help
	  Enable the QMP6988 barometric pressure sensor driver (I2C 0x70).
	  Part of the M5Stack ENV III unit.
```

## drivers/sensor/csse4011_soil/Kconfig
```kconfig
config CSSE4011_SOIL
	bool "SparkFun soil moisture sensor driver"
	depends on SENSOR
	depends on ADC
	default n
	help
	  Enable the SparkFun soil moisture sensor driver on AIN0 (P0.02 / D0).
```

## drivers/sensor/csse4011_tmp36/Kconfig
```kconfig
config CSSE4011_TMP36
	bool "CSSE4011 TMP36 sensor driver"
	depends on SENSOR
	depends on ADC
	default n
	help
	  Enable the CSSE4011 TMP36 sensor driver.
```

## dts/bindings/csse4011,qmp6988.yaml
```yaml
description: QMP6988 barometric pressure sensor (I2C)

compatible: "csse4011,qmp6988"

include: [base.yaml, i2c-device.yaml]
```

## dts/bindings/csse4011,soil.yaml
```yaml
description: SparkFun soil moisture sensor ADC driver

compatible: "csse4011,soil"

include: base.yaml
```

## dts/bindings/csse4011,tmp36.yaml
```yaml
description: CSSE4011 Temp ADC sensor

compatible: "csse4011,tmp36"

include: base.yaml
```

## dts/bindings/csse4011,trim.yaml
```yaml
description: CSSE4011 Trimpot ADC sensor

compatible: "csse4011,trim"

include: base.yaml
```
