## CMakeLists.txt
```
# SPDX-License-Identifier: Apache-2.0
cmake_minimum_required(VERSION 3.20.0)

find_package(Zephyr REQUIRED HINTS $ENV{ZEPHYR_BASE})
project(base_node)

list(APPEND CMAKE_MODULE_PATH ${ZEPHYR_BASE}/modules/nanopb)
include(nanopb)

zephyr_nanopb_sources(app ../nanopb_driver/src/sensor_config.proto ../nanopb_driver/src/sensor_info.proto)

FILE(GLOB app_sources src/*.c)
target_sources(app PRIVATE ${app_sources})
target_include_directories(app PRIVATE include ${CMAKE_CURRENT_SOURCE_DIR}/../nanopb_driver/include)
```

## Kconfig
```
# Private config options for nanopb app

# Copyright (c) 2024 Basalte bv
# SPDX-License-Identifier: Apache-2.0

mainmenu "Nanopb Configs"

config SENSOR_NUM
	int "Number of sensors in system"
	default 4
	help
	  Configure the number of sensors stored.

config MAC_BYTES
    int "Number of bytes in a mac address"
    default 6
    help
        Configure the length in bytes of a mac address

config NUM_READINGS
    int "Number of data readings taken from sensor before erasure of files"
        default 2
        help
            Configure the number of readings taken from sensors before erasing data

source "Kconfig.zephyr"
```

## prj.conf
```kconfig
# This is for the NUS BLE.
CONFIG_BT=y
CONFIG_BT_PERIPHERAL=y
CONFIG_BT_DEVICE_NAME="BaseNode"
CONFIG_BT_ZEPHYR_NUS=y
CONFIG_BT_MAX_CONN=1
CONFIG_BT_L2CAP_TX_MTU=247
CONFIG_BT_BUF_ACL_RX_SIZE=251
CONFIG_BT_BUF_ACL_TX_SIZE=251
CONFIG_FPU=y
CONFIG_FPU_SHARING=y
CONFIG_UDC_DRIVER_LOG_LEVEL_OFF=y
CONFIG_NANOPB=y




CONFIG_SHELL=y
CONFIG_SHELL_BACKEND_SERIAL=y

CONFIG_JSON_LIBRARY=y
```

## src/main.c
```c
#include <zephyr/kernel.h>
#include <zephyr/logging/log.h>
#include <zephyr/shell/shell.h>
#include <zephyr/bluetooth/bluetooth.h>
#include <zephyr/bluetooth/hci.h>
#include <zephyr/bluetooth/conn.h>
#include <zephyr/bluetooth/uuid.h>
#include <zephyr/bluetooth/gatt.h>
#include <zephyr/bluetooth/services/nus.h>
#include <zephyr/sys/slist.h>
#include <string.h>
#include <stdlib.h>
#include <sensor_config.pb.h>
#include <sensor_info.pb.h>
#include "nanopb_types.h"
#include "base_pb.h"
#include "base_json.h"

LOG_MODULE_REGISTER(base_node, LOG_LEVEL_INF);

static int match_name_to_mac(SensorNode* decoded_sensor, sys_slist_t* base_nodes, char* name);

/* ==========================================================================
 * Sensor Registry — Zephyr singly-linked list
 *
 * sensor_entry   : the actual sensor data (stored in a static pool)
 * sensor_container : wraps sensor_entry with a sys_snode_t for the list
 *
 * Shell commands:
 *   sensor add    <name> <addr_type 0|1> <b0> <b1> <b2> <b3> <b4> <b5>
 *   sensor remove <name>
 *   sensor config <name> automate <0|1>
 *   sensor config <name> period   <seconds>
 *   sensor config <name> trigger  <0-100>
 *   sensor list
 * ========================================================================== */
#define MAX_SENSORS CONFIG_SENSOR_NUM
#define SENSOR_DECOMP_STACK 2*4096
#define JSON_CONSTRUCT_STACK 4*4096
#define SENSOR_DECOMP_PRIO 6
static const char* MOBILE_NAME = "MobileNode";
static bool mobile_seen = false;

//A struct containing encoded information
//received from a BLE transmission from the Mobile Node
struct MobileRx {
	uint8_t encoded[255];
	uint16_t length;
};

struct sensor_entry {
	char         name[32];
	bt_addr_le_t addr;
	SensorConfig config;   /* automate, water_period, water_trigger */
};

struct sensor_container {
	sys_snode_t        node;
	struct sensor_entry *sensor;
};

/* Static pool — same pattern as mini project beacon_info/node_container arrays */
static struct sensor_entry    sensor_pool[MAX_SENSORS];
static struct sensor_container containers[MAX_SENSORS];
static bool                   slot_used[MAX_SENSORS];

/* The linked list and its mutex */
static sys_slist_t sensor_ll;
K_MUTEX_DEFINE(sensor_ll_mutex);


K_MSGQ_DEFINE(sensors_decomp_msgq,
              sizeof(struct MobileRx),
              4,
              4);

K_MSGQ_DEFINE(nodes_json_msgq,
              Nodes_size,
              4,
              4);


/**
 * Thread dedicated to decoding a received Nodes struct sent from the Mobile Node, containing
 * information about all nodes visited on a muling rotation
 */

static void sensors_decomp_thread_fn(void *a, void *b, void *c) {

	ARG_UNUSED(a); ARG_UNUSED(b); ARG_UNUSED(c);

	struct MobileRx mobile_rx;
	int ret;

	while(1) {
		//wait on a queue of received data from the mobile node
		k_msgq_get(&sensors_decomp_msgq, &mobile_rx, K_FOREVER);
		printk("AllNodes struct buffer received!\n");
		//we now have information passed to us, we need to decode the Nodes struct
		Nodes nodes = Nodes_init_zero;
		//decode the encoded NanoPB buffer received from the queue
		ret = base_decode(mobile_rx.encoded, mobile_rx.length, NODES, &nodes);
		if (ret < 0) {
			printk("Error, issue with decoding Nodes struct coming from mobile node\n");
		}

		for (int i = 0; i < nodes.nodes_count; i++) {
			//Retrieve a SensorNode Struct from the Nodes struct
			SensorNode current_node = nodes.nodes[i];
			printk("MAC: {%02hhX:%02hhX:%02hhX:%02hhX:%02hhX:%02hhX} BLE_time: {%d}\n", 
				current_node.mac_address[0], current_node.mac_address[1],
				current_node.mac_address[2], current_node.mac_address[3],
				current_node.mac_address[4], current_node.mac_address[5],
				current_node.sensor_sees_mobile);
			for (int j = 0; j < current_node.readings_count; j++) {
				//retrieve the readings 
				DataReadings reading = current_node.readings[j];
				printk("Temp: {%d} Humidity: {%d} Pressure: {%d} Moisture: {%d} Meas_time: {%d}\n", 
					reading.temp, reading.humidity, reading.pressure, reading.moisture,
					reading.meas_time);
			}
		}

		//Insert the decoded Nodes struct into the queue leading to the thread
		//which creates JSON packets out of each Sensor Node
		ret = k_msgq_put(&nodes_json_msgq, &nodes, K_NO_WAIT);
		if (ret < 0) {
			printk("Error putting Nodes into json queue: %d\n", ret);
		}

		k_sleep(K_MSEC(1));
	}
}

K_THREAD_DEFINE(sensors_decomp_thread, SENSOR_DECOMP_STACK,
		sensors_decomp_thread_fn, NULL, NULL, NULL,
		SENSOR_DECOMP_PRIO, 0, 0);

/**
 * Thread dedicated to constructing JSON packets for each individual SensorNode
 * packet of information received from the Mobile Node within a Nodes struct
 */

static void json_nodes_thread_fn(void *a, void *b, void *c) {

	ARG_UNUSED(a); ARG_UNUSED(b); ARG_UNUSED(c);

	int ret;
	Nodes nodes = Nodes_init_zero;

	while(1) {
		//wait on a decoded Nodes struct received from the Mobile Node
		k_msgq_get(&nodes_json_msgq, &nodes, K_FOREVER);

		//For each SensorNode within Nodes, create a JSON packet
		for (int i = 0; i < nodes.nodes_count; i++) {
			//set up a buffer to read name into
			char matched_name[32];
			//buffer to read created JSON packets into
			char json_buffer[512];

			//lock up the linked list
			k_mutex_lock(&sensor_ll_mutex, K_FOREVER);
			//Find the matching name for the current SensorNode struct's MAC address
			ret = match_name_to_mac(&nodes.nodes[i], &sensor_ll, matched_name);
			k_mutex_unlock(&sensor_ll_mutex);

			if (ret < 0) {
				printk("Error matching name to mac when making json\n");
			}

			//now we have a name, pass the name and the sensor node to json function
			ret = create_sensor_json(&nodes.nodes[i], matched_name, json_buffer, nodes.mobile_sees_base);
			if (ret < 0) {
				printk("Error in thread creating json: %d\n", ret);
			}

			//we have a functioning json buffer, print it
			printk("%s\n", json_buffer);

		}

		k_sleep(K_MSEC(1));
	}
}

K_THREAD_DEFINE(json_nodes_thread, JSON_CONSTRUCT_STACK,
		json_nodes_thread_fn, NULL, NULL, NULL,
		SENSOR_DECOMP_PRIO, 0, 0);

/**
 * Searches through the Base Node's linked list of Sensor Nodes in the system 
 * in order to find the name that was attached by the user to a particular Sensor Node's
 * MAC address 
 * 
 * @param decoded_sensor SensorNode struct received within a Nodes struct sent by the Mobile Node
 * @param base_nodes The Base Node's linked list of Sensor Nodes currently in the system
 * @param name A buffer to read the retrieved name for the received MAC address into
 * 
 * @return 0 upon sucessfully matching the MAC address to its configured name, -1 otherwise
 */

static int match_name_to_mac(SensorNode* decoded_sensor, sys_slist_t* base_nodes, char* name) {
	//iterate through the linked list
	struct sensor_container *c;
	SYS_SLIST_FOR_EACH_CONTAINER(base_nodes, c, node) {
		bool match = true;
		//compare each value in the ll address and the decoded sensor addresss
		for (int i = 0; i < CONFIG_MAC_BYTES; i++) {
			//Grab current entry of this list node's mac address
			uint8_t list_addr_piece = c->sensor->addr.a.val[i];
			uint8_t decoded_addr_piece = decoded_sensor->mac_address[i];
			if (list_addr_piece != decoded_addr_piece) {
				match = false;
				break;
			}
		}
		if (match) {
			memcpy(name, c->sensor->name, 32);
			return 0;
		} else {
			match = true;
		}
	}

	//no match was ever found
	return -1;
	
}

/* ==========================================================================
 * Internal helpers
 * ========================================================================== */

/* Find a sensor entry in the list by name */
static struct sensor_container *find_container_by_name(const char *name)
{
	struct sensor_container *c;
	SYS_SLIST_FOR_EACH_CONTAINER(&sensor_ll, c, node) {
		if (strcmp(c->sensor->name, name) == 0) {
			return c;
		}
	}
	return NULL;
}

/* Add a sensor to the linked list by pool index */
static void sensor_ll_add(int index)
{
	k_mutex_lock(&sensor_ll_mutex, K_FOREVER);
	sys_slist_append(&sensor_ll, &containers[index].node);
	k_mutex_unlock(&sensor_ll_mutex);
}

/* Remove a sensor from the linked list by pool index */
static void sensor_ll_remove(int index)
{
	k_mutex_lock(&sensor_ll_mutex, K_FOREVER);
	sys_slist_find_and_remove(&sensor_ll, &containers[index].node);
	k_mutex_unlock(&sensor_ll_mutex);
}

/* ==========================================================================
 * Shell Commands
 * ========================================================================== */

/* sensor add <name> <type 0|1> <b0>..<b5>  (hex bytes LSB first)
 * e.g.  sensor add garden 1 B9 F3 1A 0D 82 F4  */
static int cmd_add(const struct shell *sh, size_t argc, char **argv)
{
	if (argc < 9) {
		shell_error(sh, "Usage: sensor add <name> <type 0|1> <b0> <b1> <b2> <b3> <b4> <b5>");
		shell_error(sh, "  e.g. sensor add garden 1 B9 F3 1A 0D 82 F4");
		return -EINVAL;
	}

	k_mutex_lock(&sensor_ll_mutex, K_FOREVER);
	bool exists = (find_container_by_name(argv[1]) != NULL);
	k_mutex_unlock(&sensor_ll_mutex);

	if (exists) {
		shell_error(sh, "Sensor '%s' already exists", argv[1]);
		return -EEXIST;
	}

	/* Find a free slot in the pool */
	int slot = -1;
	for (int i = 0; i < MAX_SENSORS; i++) {
		if (!slot_used[i]) { slot = i; break; }
	}
	if (slot < 0) {
		shell_error(sh, "Registry full (%d sensors max)", MAX_SENSORS);
		return -ENOMEM;
	}

	/* Fill the pool entry */
	struct sensor_entry *e = &sensor_pool[slot];
	strncpy(e->name, argv[1], sizeof(e->name) - 1);
	e->addr.type = (uint8_t)strtoul(argv[2], NULL, 10);
	for (int i = 0; i < 6; i++) {
		e->addr.a.val[i] = (uint8_t)strtoul(argv[3 + i], NULL, 16);
	}
	/* Default config: automate=off, period=10s, trigger=50% */
	e->config.automate      = false;
	e->config.water_period  = 10;
	e->config.water_trigger = 50;

	/* Link the container to this pool slot and append to list */
	containers[slot].sensor = e;
	slot_used[slot] = true;
	sensor_ll_add(slot);

	char addr_str[BT_ADDR_LE_STR_LEN];
	bt_addr_le_to_str(&e->addr, addr_str, sizeof(addr_str));
	shell_print(sh, "Added '%s'  addr=%s  automate=off  period=10  trigger=50",
		    e->name, addr_str);
	return 0;
}

/* sensor remove <name> */
static int cmd_remove(const struct shell *sh, size_t argc, char **argv)
{
	if (argc < 2) {
		shell_error(sh, "Usage: sensor remove <name>");
		return -EINVAL;
	}

	k_mutex_lock(&sensor_ll_mutex, K_FOREVER);
	struct sensor_container *c = find_container_by_name(argv[1]);
	k_mutex_unlock(&sensor_ll_mutex);

	if (!c) {
		shell_error(sh, "Sensor '%s' not found", argv[1]);
		return -ENOENT;
	}

	/* Find the pool slot so we can mark it free */
	int slot = (int)(c - containers);
	sensor_ll_remove(slot);
	memset(&sensor_pool[slot], 0, sizeof(sensor_pool[slot]));
	slot_used[slot] = false;

	shell_print(sh, "Removed '%s'", argv[1]);
	return 0;
}

/* sensor config <name> automate <0|1>
   sensor config <name> period   <seconds>
   sensor config <name> trigger  <0-100>    */
static int cmd_config(const struct shell *sh, size_t argc, char **argv)
{
	if (argc < 4) {
		shell_error(sh, "Usage: sensor config <name> <automate|period|trigger> <value>");
		return -EINVAL;
	}

	k_mutex_lock(&sensor_ll_mutex, K_FOREVER);
	struct sensor_container *c = find_container_by_name(argv[1]);
	k_mutex_unlock(&sensor_ll_mutex);

	if (!c) {
		shell_error(sh, "Sensor '%s' not found", argv[1]);
		return -ENOENT;
	}

	struct sensor_entry *e = c->sensor;

	if (strcmp(argv[2], "automate") == 0) {
		e->config.automate = (bool)atoi(argv[3]);
		shell_print(sh, "%s: automate = %s", e->name,
			    e->config.automate ? "on" : "off");
	} else if (strcmp(argv[2], "period") == 0) {
		e->config.water_period = atoi(argv[3]);
		shell_print(sh, "%s: water_period = %d s", e->name, e->config.water_period);
	} else if (strcmp(argv[2], "trigger") == 0) {
		e->config.water_trigger = atoi(argv[3]);
		shell_print(sh, "%s: water_trigger = %d%%", e->name, e->config.water_trigger);
	} else {
		shell_error(sh, "Unknown field '%s' — use automate, period, or trigger", argv[2]);
		return -EINVAL;
	}
	return 0;
}

/* sensor list */
static int cmd_list(const struct shell *sh, size_t argc, char **argv)
{
	k_mutex_lock(&sensor_ll_mutex, K_FOREVER);

	int count = 0;
	struct sensor_container *c;
	SYS_SLIST_FOR_EACH_CONTAINER(&sensor_ll, c, node) {
		char addr_str[BT_ADDR_LE_STR_LEN];
		bt_addr_le_to_str(&c->sensor->addr, addr_str, sizeof(addr_str));
		shell_print(sh, "[%d] %-16s  addr=%-30s  automate=%-3s  period=%ds  trigger=%d%%",
			    count, c->sensor->name, addr_str,
			    c->sensor->config.automate ? "on" : "off",
			    c->sensor->config.water_period,
			    c->sensor->config.water_trigger);
		count++;
	}

	k_mutex_unlock(&sensor_ll_mutex);

	if (count == 0) {
		shell_print(sh, "No sensors registered. Use: sensor add <name> <type> <b0..b5>");
	}
	return 0;
}

SHELL_STATIC_SUBCMD_SET_CREATE(sub_sensor,
	SHELL_CMD_ARG(add,    NULL,
		"Add:    sensor add <name> <type 0|1> <b0>..<b5>  (hex, LSB first)",
		cmd_add, 9, 0),
	SHELL_CMD_ARG(remove, NULL,
		"Remove: sensor remove <name>",
		cmd_remove, 2, 0),
	SHELL_CMD_ARG(config, NULL,
		"Config: sensor config <name> <automate|period|trigger> <value>",
		cmd_config, 4, 0),
	SHELL_CMD_ARG(list,   NULL,
		"List all registered sensors",
		cmd_list, 1, 0),
	SHELL_SUBCMD_SET_END
);

SHELL_CMD_REGISTER(sensor, &sub_sensor, "Sensor node management", NULL);

/* ==========================================================================
 * NUS RX Callback
 * ========================================================================== */
static void nus_received(struct bt_conn *conn, const void *data, uint16_t len,
			 void *ctx)
{
	//grab the data and put it into a struct
	struct MobileRx mobile_rx;

	mobile_rx.length = len;

	//copy the data from data to mobile rx buffer
	memcpy(mobile_rx.encoded, (uint8_t *)data, len);

	//put the struct into the queue
	int ret = k_msgq_put(&sensors_decomp_msgq, &mobile_rx, K_NO_WAIT);
		if (ret != 0) {
			printk("queue failed: %d\n", ret);
		}

}

static void nus_notif_enabled(bool enabled, void *ctx)
{
	if (!enabled) {
		return;
	}
    int ret;

	printk("Mobile subscribed - sending sensor data\n");

	AllConfigs all_configs = AllConfigs_init_zero;

	k_mutex_lock(&sensor_ll_mutex, K_FOREVER);
	int count = 0;
	struct sensor_container *c;
	SYS_SLIST_FOR_EACH_CONTAINER(&sensor_ll, c, node) {
		char addr_str[BT_ADDR_LE_STR_LEN];
		memcpy(all_configs.configs[all_configs.configs_count].mac_address, c->sensor->addr.a.val, CONFIG_MAC_BYTES);
		all_configs.configs[all_configs.configs_count].automate = c->sensor->config.automate ? true : false;
		all_configs.configs[all_configs.configs_count].water_period = c->sensor->config.water_period;
		all_configs.configs[all_configs.configs_count].water_trigger = c->sensor->config.water_trigger;
		all_configs.configs_count++;
		count++;
	}
	k_mutex_unlock(&sensor_ll_mutex);

    // encode this bitch
    uint8_t configs_buf[AllConfigs_size];
    size_t configs_buf_len = 0;
    //encode the AllConfigs
    ret = base_encode(configs_buf, sizeof(configs_buf), &configs_buf_len, ALL_CONFIGS, &all_configs);
    if (ret < 0) {
        printk("Error with nanoPB encoding of sensor config read from file\n");
    }
	printk("after encoding");
    printk("Length of NUS packet: %d\n", (int)configs_buf_len);

	if (configs_buf_len == 0) {
		printk("No sensors configured — sending empty sentinel\n");
		uint8_t sentinel = 0x00;
		bt_nus_send(NULL, &sentinel, 1);
		return;
	}

	int err = bt_nus_send(NULL, configs_buf, configs_buf_len);
	if (err) {
		printk("Send failed (err %d)\n", err);
	} else {
		printk("Sent %d bytes\n", (int)configs_buf_len);
	}
}

/* ==========================================================================
 * BLE
 * ========================================================================== */
#define DEVICE_NAME     CONFIG_BT_DEVICE_NAME
#define DEVICE_NAME_LEN (sizeof(DEVICE_NAME) - 1)

static const struct bt_data ad[] = {
	BT_DATA_BYTES(BT_DATA_FLAGS, (BT_LE_AD_GENERAL | BT_LE_AD_NO_BREDR)),
	BT_DATA(BT_DATA_NAME_COMPLETE, DEVICE_NAME, DEVICE_NAME_LEN),
};

static const struct bt_data sd[] = {
	BT_DATA_BYTES(BT_DATA_UUID128_ALL, BT_UUID_NUS_SRV_VAL),
};

static struct bt_nus_cb nus_cb = {
	.received      = nus_received,
	.notif_enabled = nus_notif_enabled,
};

/* ==========================================================================
 * Advertising restart work
 * ========================================================================== */
static void adv_restart_work_fn(struct k_work *work)
{
	int err = bt_le_adv_start(BT_LE_ADV_CONN_FAST_1, ad, ARRAY_SIZE(ad), sd, ARRAY_SIZE(sd));
	if (err) {
		printk("Failed to restart advertising (err %d)\n", err);
	} else {
		printk("Advertising restarted, waiting for mobile...\n");
	}
}

static K_WORK_DELAYABLE_DEFINE(adv_restart_work, adv_restart_work_fn);

/* ==========================================================================
 * Connection Callbacks
 * ========================================================================== */
static void connected(struct bt_conn *conn, uint8_t err)
{
	if (err) {
		LOG_ERR("Connection failed (err %d)", err);
		return;
	}
	printk("Mobile connected, waiting for subscription...\n");
}

static void disconnected(struct bt_conn *conn, uint8_t reason)
{
	printk("Disconnected (reason 0x%02x) - restarting advertising in 1s...\n", reason);
	k_work_schedule(&adv_restart_work, K_MSEC(1000));
}

BT_CONN_CB_DEFINE(conn_callbacks) = {
	.connected    = connected,
	.disconnected = disconnected,
};

/* ==========================================================================
 * Main
 * ========================================================================== */
int main(void)
{

	int err;

	err = bt_nus_cb_register(&nus_cb, NULL);
	if (err) {
		printk("Failed to register NUS callbacks: %d\n", err);
		return err;
	}


    err = bt_enable(NULL);
	if (err) {
		printk("Failed to enable bluetooth: %d\n", err);
		return err;
	}


	printk("=== Base Node Starting ===\n");

	sys_slist_init(&sensor_ll);

	printk("Ready — use 'sensor add' to register sensors\n");

	k_sleep(K_SECONDS(3));

	err = bt_le_adv_start(BT_LE_ADV_CONN_FAST_1, ad, ARRAY_SIZE(ad), sd, ARRAY_SIZE(sd));
	if (err) {
		printk("Failed to start advertising: %d\n", err);
		return err;
	}

    // start_scan();

	printk("Base node advertising, waiting for mobile...\n");

    

	while (1) {
		k_sleep(K_FOREVER);
	}

	return 0;
}
```

## include/base_json.h
```c
#ifndef BASE_JSON_H
#define BASE_JSON_H

int create_sensor_json(void* sensor_node, char* sensor_name, char* json_buffer, int32_t mobile_sees_base);

#endif
```

## include/base_pb.h
```c
#ifndef BASE_PB_H
#define BASE_PB_H

int base_encode(uint8_t *buffer, size_t buffer_size, size_t *message_length, uint8_t type, void* message);
int base_decode(uint8_t *buffer, size_t message_length, uint8_t type, void* message);

#endif
```

## src/base_json.c
```c
#include <zephyr/kernel.h>
#include <zephyr/data/json.h>
#include <zephyr/sys/printk.h>
#include <string.h>
#include <sensor_config.pb.h>
#include <sensor_info.pb.h>
//The inner struct for an embedded JSON message

struct sensor_reading {
    int32_t temp;
    int32_t humidity;
    int32_t pressure;
    int32_t moisture;
    int32_t sensor_meas_time;
};

//outer struct representing the SensorNode
struct sensor_node {
    char* name;
    int32_t mobile_sees_sensor_time;
    int32_t mobile_sees_base_time;
    int32_t sensor_sees_mobile;
    struct sensor_reading readings[CONFIG_NUM_READINGS];
    size_t readings_len;
};

//array of JSON packet primitives for the inner struct
static const struct json_obj_descr reading_descr[] = {
    JSON_OBJ_DESCR_PRIM(struct sensor_reading, temp, JSON_TOK_NUMBER),
    JSON_OBJ_DESCR_PRIM(struct sensor_reading, humidity, JSON_TOK_NUMBER),
    JSON_OBJ_DESCR_PRIM(struct sensor_reading, pressure, JSON_TOK_NUMBER),
    JSON_OBJ_DESCR_PRIM(struct sensor_reading, moisture, JSON_TOK_NUMBER),
    JSON_OBJ_DESCR_PRIM(struct sensor_reading, sensor_meas_time, JSON_TOK_NUMBER),
};

//array of JSON packet primitives for the outside struct
static const struct json_obj_descr packet_descr[] = {

    JSON_OBJ_DESCR_PRIM(
        struct sensor_node,
        name,
        JSON_TOK_STRING
    ),

    JSON_OBJ_DESCR_PRIM(struct sensor_node, mobile_sees_sensor_time, JSON_TOK_NUMBER),
    JSON_OBJ_DESCR_PRIM(struct sensor_node, mobile_sees_base_time, JSON_TOK_NUMBER),
    JSON_OBJ_DESCR_PRIM(struct sensor_node, sensor_sees_mobile, JSON_TOK_NUMBER),

    JSON_OBJ_DESCR_OBJ_ARRAY(
        struct sensor_node,
        readings,
        CONFIG_NUM_READINGS,
        readings_len,
        reading_descr,
        ARRAY_SIZE(reading_descr)
    ),
};

static int fill_outer_struct_times(SensorNode* decoded_sensor, char* name, struct sensor_node* json_sensor, int32_t mobile_sees_base);
static int fill_outer_struct_readings(SensorNode* decoded_sensor, struct sensor_node* json_sensor);


/**
 * Creates a JSON packet representing a complete SensorNode struct received from the Mobile Node
 * 
 * @param sensor_node A SensorNode struct received from the Mobile node containing information from a Sensor Node
 * @param sensor_name The name of the Sensor Node received
 * @param json_buffer The buffer where the constructed JSON string is being sent
 * @param mobile_sees_base The time that the Mobile Node saw the Base Node for the current batch of
 * Sensor Nodes
 * 
 * @returns 0 upon sucessful creation of a JSON packet, -1 for unsuccessful creation
 */

int create_sensor_json(void* sensor_node, char* sensor_name, char* json_buffer, int32_t mobile_sees_base) {
    
    //cast the SensorNode
    SensorNode* decoded_sensor = sensor_node;
    
    //initialise the outer struct
    struct sensor_node json_sensor = {0};

    //helper function to fill outer struct fields except for repeated inner structs
    fill_outer_struct_times(decoded_sensor, sensor_name, &json_sensor, mobile_sees_base);

    //fill the repeated structs
    fill_outer_struct_readings(decoded_sensor, &json_sensor);

    //now encode to the buffer
    int ret = json_obj_encode_buf(packet_descr, ARRAY_SIZE(packet_descr), &json_sensor, json_buffer, (size_t)(512));
    if (ret < 0) {
        printk("Error encoding SensorNode info: %d\n", ret);
        return ret;
    }
    return 0;
}

/**
 * Function to fill the outermost struct of a JSON packet with timestamp information
 * 
 * @param decoded_sensor A SensorNode struct received from the mobile node
 * @param name The name of a SensorNode struct received from the mobile node
 * @param json_sensor The JSON struct of information that represents the JSON format for a Sensor Node
 * @param mobile_sees_base The time that the Mobile Node saw the Base Node for the current batch of
 * Sensor Nodes
 */

static int fill_outer_struct_times(SensorNode* decoded_sensor, char* name, struct sensor_node* json_sensor, int32_t mobile_sees_base) {

    //set information carries in SensorNode struct decoded from mobile
    json_sensor->name = name;
    json_sensor->mobile_sees_sensor_time = decoded_sensor->mobile_sees_sensor;
    json_sensor->mobile_sees_base_time = mobile_sees_base;
    json_sensor->sensor_sees_mobile = decoded_sensor->sensor_sees_mobile;
    json_sensor->readings_len = decoded_sensor->readings_count;

    return 0;
}


/**
 * Function to fill the outermost struct of a JSON packet with timestamp information
 * 
 * @param decoded_sensor A SensorNode struct received from the mobile node
 * @param json_sensor The JSON struct of information that represents the JSON format for a Sensor Node
 */

static int fill_outer_struct_readings(SensorNode* decoded_sensor, struct sensor_node* json_sensor) {
    //loop through the number of readings
    for (int i = 0; i < CONFIG_NUM_READINGS; i++) {
        json_sensor->readings[i].temp = decoded_sensor->readings[i].temp;
        json_sensor->readings[i].humidity = decoded_sensor->readings[i].humidity;
        json_sensor->readings[i].pressure = decoded_sensor->readings[i].pressure;
        json_sensor->readings[i].moisture = decoded_sensor->readings[i].moisture;
        json_sensor->readings[i].sensor_meas_time = decoded_sensor->readings[i].meas_time;
    }
    return 0;
}
```

## src/base_pb.c
```c
#include <sensor_config.pb.h>
#include <sensor_info.pb.h>
#include <pb_encode.h>
#include <pb_decode.h>
#include <string.h>
#include <stdlib.h>
#include <stdio.h>
#include <stddef.h>
#include "base_pb.h"
#include "nanopb_types.h"
#include <zephyr/kernel.h>

static bool encode_all_configs(uint8_t *buffer, size_t buffer_size, size_t *message_length, void *message);
static bool decode_nodes(uint8_t *buffer, size_t message_length, void* message);

/************************************************
 *  Entry function for encoding of structs relevant to the base node
 * 
 * @param buffer a buffer which the encoded struct bytes will be written to
 * @param buffer_size Space available in the buffer to write to, overflows will trigger a streaming error
 * @param message_length the number of bytes read into the buffer during streaming process
 * @param type the type of struct that should be encoded
 * @param message Pointer to the struct to encode
 *************************************************/

int base_encode(uint8_t *buffer, size_t buffer_size, size_t *message_length, uint8_t type, void* message) {
    if (type == ALL_CONFIGS) {
        //Call the all configs encode function
        if (encode_all_configs(buffer, buffer_size, message_length, message)) {
            return 0;
        } else {
            return -1;
        }
    } else {
        //error, incorrect type passed, print errorr and return -1
        printk("Incorrect struct type given to base message encoding\n");
        return -1;
    }
}

/************************************************
 *  Encoder function for struct of AllConfigs type
 * 
 * @param buffer a buffer which the encoded struct bytes will be read into
 * @param buffer_size Space available in the buffer to write to, overflows will trigger a streaming error
 * @param message_length the number of bytes read into the buffer during streaming process
 * @param message Pointer to the struct to encode
 *************************************************/

static bool encode_all_configs(uint8_t *buffer, size_t buffer_size, size_t *message_length, void *message) {
    bool status;

    //Grab the correct type of struct
    AllConfigs *configs = message;

	/* Create a stream that will write to our buffer. */
	pb_ostream_t stream = pb_ostream_from_buffer(buffer, buffer_size);
	
	/* Now we are ready to encode the message! */
	status = pb_encode(&stream, AllConfigs_fields, configs);
	*message_length = stream.bytes_written;
	printk("Number of AllConfigs bytes written: %d\n", (int) stream.bytes_written);

	if (!status) {
		printk("Encoding AllConfigs struct failed: %s\n", PB_GET_ERROR(&stream));
	} else {
        printk("Encoded AllConfigs struct\n");
    }

	return status;
}

/************************************************
 *  Entry function for decoding of structs relevant to the Base node
 * 
 * @param buffer a buffer which the encoded struct bytes will be read from
 * @param message_length the number of bytes to read from the buffer
 * @param type the type of struct that should be decoded
 * @param message Pointer to the struct to write decoded information to
 *************************************************/
int base_decode(uint8_t *buffer, size_t message_length, uint8_t type, void* message) {
    if (type == NODES) {
        if (decode_nodes(buffer, message_length, message)) {
            return 0;
        } else {
            return -1;
        }
    } else {
        //incorrect type passed to the base decoding function
        printk("Incorrect struct type passed to the base decode\n");
        return -1;
    }
}

/************************************************
 *  Decoder function for Nodes type struct
 * 
 * @param buffer a buffer which the encoded struct bytes will be read from
 * @param message_length the number of bytes to read from the buffer
 * @param message Pointer to the struct to write decoded information to
 *************************************************/
static bool decode_nodes(uint8_t *buffer, size_t message_length, void* message) {
    
    bool status;
    //assume that we are being passed a struct that has been initialised properly
	Nodes *nodes = message;

	/* Create a stream that reads from the buffer. */
	pb_istream_t stream = pb_istream_from_buffer(buffer, message_length);

	/* Now we are ready to decode the message. */
	status = pb_decode(&stream, Nodes_fields, nodes);

	/* Check for errors... */
	if (status) {
		/* Print the data contained in the message. */
		printk("Successfully Decoded Nodes struct");
		printk("\n");
		pb_release(Nodes_fields, nodes);
	} else {
		printk("Decoding Nodes struct failed: %s\n", PB_GET_ERROR(&stream));
	}

	return status;
}
```
